## sources/meta-miner/conf/machine/c2-evt.conf
```bitbake
#@TYPE: Machine
#@NAME: c2-evt
#@DESCRIPTION: STM32MP131F C2 board w/ only eMMC
#@NEEDED_BSPLAYERS: layers/meta-openembedded/meta-oe layers/meta-openembedded/meta-python

include include/cx_common.inc
PRODUCT_FAMILY = "C2"

# =========================================================================
# Machine settings
# =========================================================================
# Devicetree used for optee, u-boot and kernel
MINER_DEVICETREE = "stm32mp131f-c2evt"

# Setup device tree related config
include include/device_tree.inc

# =========================================================================
# OPTEE settings
# =========================================================================
include include/optee.inc

# =========================================================================
# Secure boot settings
# =========================================================================
include include/secureboot.inc

# =========================================================================
# Signed swupdate
# =========================================================================
include include/signed_swupdate.inc
```

## sources/meta-miner/conf/machine/c2-p1.conf
```bitbake
#@TYPE: Machine
#@NAME: c2-p1
#@DESCRIPTION: STM32MP131F C2 Proto1 board w/ only eMMC
#@NEEDED_BSPLAYERS: layers/meta-openembedded/meta-oe layers/meta-openembedded/meta-python

include include/cx_common.inc
PRODUCT_FAMILY = "C2"

# =========================================================================
# Machine settings
# =========================================================================
# Devicetree used for optee, u-boot and kernel
MINER_DEVICETREE = "stm32mp131f-c2p1"

# Setup device tree related config
include include/device_tree.inc

# =========================================================================
# OPTEE settings
# =========================================================================
include include/optee.inc

# =========================================================================
# Secure boot settings
# =========================================================================
include include/secureboot.inc

# =========================================================================
# Signed swupdate
# =========================================================================
include include/signed_swupdate.inc
```

## sources/meta-miner/conf/machine/c3-p1.conf
```bitbake
#@TYPE: Machine
#@NAME: c3-p1
#@DESCRIPTION: STM32MP131F C3 Proto1 board w/ only eMMC
#@NEEDED_BSPLAYERS: layers/meta-openembedded/meta-oe layers/meta-openembedded/meta-python

include include/cx_common.inc
# Define common machine platform
PRODUCT_FAMILY = "C3"

# =========================================================================
# Machine settings
# =========================================================================
# Devicetree used for optee, u-boot and kernel
MINER_DEVICETREE = "stm32mp131f-c3p1"

# Override MINER_DEVICETREE and add additional device trees for kernel
STM32MP_KERNEL_DEVICETREE = "stm32mp131f-c3p1.dtb stm32mp131f-c3p1-io-rgb.dtb"

# Setup device tree related config
include include/device_tree.inc

# =========================================================================
# OPTEE settings
# =========================================================================
include include/optee.inc

# =========================================================================
# Secure boot settings
# =========================================================================
include include/secureboot.inc

# =========================================================================
# Signed swupdate
# =========================================================================
include include/signed_swupdate.inc
```

## sources/meta-miner/conf/machine/include/device_tree.inc
```bitbake
STM32MP_DEVICETREE = "${MINER_DEVICETREE}"
DEVICE_BOARD_ENABLE:EMMC += "${@bb.utils.contains('BOOTDEVICE_LABELS', 'emmc', '${MINER_DEVICETREE}', '', d)}"
```

## sources/meta-miner/conf/machine/include/optee.inc
```bitbake
FIP_DEVICETREE_OPTEE = "${MINER_DEVICETREE}"
DISTRO_FEATURES:append = " optee"
IMAGE_INSTALL:append = " optee-os-stm32mp"
```

## sources/meta-miner/conf/machine/include/signed_swupdate.inc
```bitbake
SWUPDATE_SIGNING = "RSA"
SWUPDATE_PRIVATE_KEY = "${STAGING_DATADIR_NATIVE}/swupdate_dev_keys/priv.pem"
SWUPDATE_PUBLIC_KEY = "${STAGING_DATADIR_NATIVE}/swupdate_dev_keys/public.pem"
SWUPDATE_PASSWORD_FILE = "${STAGING_DATADIR_NATIVE}/swupdate_dev_keys/passout"
```

## sources/meta-miner/conf/machine/stm32mp135f-dk.conf
```bitbake
#@TYPE: Machine
#@NAME: stm32mp135f-dk
#@DESCRIPTION: [EXAMPLE] STM32MP135F-DK board ONLY with Optee boot and SDcard support
#@NEEDED_BSPLAYERS: layers/meta-openembedded/meta-oe layers/meta-openembedded/meta-python

include conf/machine/include/st-machine-common-stm32mp.inc
include conf/machine/include/st-machine-providers-stm32mp.inc

# Define specific familly common machine name
MACHINEOVERRIDES .= ":stm32mp1common:stm32mp13common"

# =========================================================================
# Chip architecture
# =========================================================================
DEFAULTTUNE = "cortexa7thf-neon-vfpv4"
include conf/machine/include/arm/armv7a/tune-cortexa7.inc

# =========================================================================
# boot scheme
# =========================================================================
BOOTSCHEME_LABELS += "optee"

# =========================================================================
# boot device
# =========================================================================
# Define the boot device supported
BOOTDEVICE_LABELS += "sdcard"

#BOOTDEVICE_LABELS += "emmc"
#BOOTDEVICE_LABELS += "nand-4-256"
#BOOTDEVICE_LABELS += "nor-sdcard"

# =========================================================================
# Machine settings
# =========================================================================
# Define list of devicetree per board
STM32MP_DT_FILES_DK += "stm32mp135f-dk"

# =========================================================================
# OPTEE settings
# =========================================================================
FIP_DEVICETREE_OPTEE = "stm32mp135f-dk"
DISTRO_FEATURES:append = " optee"
IMAGE_INSTALL:append = " optee-os-stm32mp"

#IMAGE_INSTALL:append = " optee-client optee-examples"

# =========================================================================
# Machine features
# =========================================================================
#MACHINE_FEATURES += "splashscreen"
#MACHINE_FEATURES += "watchdog"
#MACHINE_FEATURES += "bluetooth"
#MACHINE_FEATURES += "wifi"
#MACHINE_FEATURES += "nosmp"
#MACHINE_FEATURES += "usbg0"

# Bluetooth
#BLUETOOTH_LIST += "linux-firmware-bluetooth-bcm4343"
# Wifi
#WIFI_LIST += "linux-firmware-bcm43430"

# =========================================================================
# Kernel
# =========================================================================
# Define the devicetree for Linux A7 examples
#LINUX_A7_EXAMPLES_DT += "stm32mp135f-dk-a7-examples"

# =========================================================================
# WIC for sdcard raw image
# =========================================================================
ST_VENDORFS = "0"
ST_USERFS   = "0"

WIC_CREATE_EXTRA_ARGS = "--no-fstab-update"
WKS_FILE_DEPENDS ?= " \
    virtual/bootloader \
    virtual/trusted-firmware-a \
    ${@bb.utils.contains('BOOTSCHEME_LABELS', 'optee', 'virtual/optee-os', '', d)} \
    st-image-bootfs \
    ${@bb.utils.contains('ST_VENDORFS','1','st-image-vendorfs', '', d)} \
"
OPTEE_WIC_FILE = "${@bb.utils.contains('ST_VENDORFS','1','sdcard-stm32mp135f-dk-optee-vendorfs-1GB.wks.in','sdcard-stm32mp1-256MB-optee.wks.in',d)}"

# for generated a WIC file, please uncomment the 2 following lines or add them to local.conf
WKS_IMAGE_FSTYPES += "wic wic.bz2 wic.bmap"
WKS_FILE += "${OPTEE_WIC_FILE}"
```

## sources/meta-miner/recipes-bsp/u-boot/files/u-boot-scr-fit-image.its
```
/dts-v1/;

/ {
        description = "U-boot script fitImage for Proto Embedded Linux Distribution";
        #address-cells = <1>;

        images {
                default = "boot-script";
                boot-script {
                        description = "U-boot script";
                        data = /incbin/("@@BOOTSCR@@");
                        type = "script";
                        compression = "none";
                        hash-1 {
                                algo = "sha256";
                        };
                };
        };

        configurations {
                default = "bootscr";
                 bootscr {
                        description = "boot script";
                        script = "boot-script";

                        hash-1 {
                                algo = "sha256";
                        };
                        signature-1 {
                                algo = "sha256,rsa2048";
                                key-name-hint = "@@UBOOT_SIGN_KEYNAME@@";
                                padding = "pkcs-1.5";
                                sign-images = "script";
                        };
                };
        };
};
```
